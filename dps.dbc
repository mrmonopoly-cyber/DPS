VERSION "1.0"

NS_ :

BS_:

BU_: MASTER SLAVE

BO_ 650 DpsSlaveMex: 8 SLAVE
 SG_ Mode: 0|4@1+ (1,0) [0|15] "slave mex type" M

 //Mode = 0 board name
 SG_ id : 4|4@1+ (1,0) [0|15] "slave board id" M0
 SG_ board_name : 8|56@1+ (1,0) [0|0] "slave board name" M0

 //Mode = 1 var name
 SG_ board_id : 4|4@1+ (1,0) [0|15] "slave board id" M1
 SG_ var_id : 8|4@1+ (1,0) [0|15] "slave var id" M1
 SG_ var_name : 16|48@1+ (1,0) [0|0] "slave var name" M1

 //Mode = 2 var metadata
 SG_ board_id : 4|4@1+ (1,0) [0|15] "slave board id" M2
 SG_ var_id : 8|4@1+ (1,0) [0|15] "slave var id" M2
 SG_ type : 12|2@1+ (1,0) [0|2] "slave var type" M2
 SG_ size : 14|2@1+ (1,0) [0|2] "slave var size" M2

 //Mode = 3 var value
 SG_ board_id : 4|4@1+ (1,0) [0|15] "slave board id" M3
 SG_ var_id : 8|4@1+ (1,0) [0|15] "slave var id" M3
 SG_ value : 16|32@1+ (1,0) [0|2] "slave var value" M3

BO_ 651 DpsMasterMex: 8 SLAVE
 SG_ Mode: 0|4@1+ (1,0) [0|15] "slave mex type" M

 //Mode = 0 Discover Boards
 SG_ reserved: 4|1@1+ (1,0) [0|0] "" M0

 //Mode = 1 Request Infos Board
 SG_ board_id : 4|4@1+ (1,0) [0|15] "slave board id" M1

 //Mode = 2 Request var value Board
 SG_ board_id : 4|4@1+ (1,0) [0|15] "slave board id" M2
 SG_ var_id : 8|4@1+ (1,0) [0|15] "slave var id" M2

 //Mode = 3 Update var value Board
 SG_ board_id : 4|4@1+ (1,0) [0|15] "slave board id" M3
 SG_ var_id : 8|4@1+ (1,0) [0|15] "slave var id" M3
 SG_ value: 16|32@1+ (1,0) [0|0] "slave var value" M3

VAL_ 650 Mode 0 "BoardName" 1 "VarName" 2 "VarMetadata" 3 "VarValue"
VAL_ 651 Mode 0 "Discover Boards" 1 "Request Infos Board" 2 "Req var value" 3 "Update var value"
VAL_ 650 type 0 "Integer" 1 "Float" 2 "String"
VAL_ 650 size 0 "8-bit" 1 "16-bit" 2 "32-bit"
